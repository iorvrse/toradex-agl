## meta-toradex-agl/conf/layer.conf
```bitbake
# We have a conf and classes directory, add to BBPATH
BBPATH .= ":${LAYERDIR}"

# We have recipes-* directories, add to BBFILES
BBFILES += "${LAYERDIR}/recipes-*/*/*.bb ${LAYERDIR}/recipes-*/*/*.bbappend"

BBFILE_COLLECTIONS += "toradex-agl"
BBFILE_PATTERN_toradex-agl := "^${LAYERDIR}"
BBFILE_PRIORITY_toradex-agl = "8"

BBMASK += "/meta-agl/meta-agl-profile-core/recipes-support/opencv/opencv_4.%.bbappend"
BBMASK += "/meta-agl-demo/recipes-graphics/ttf-fonts/ttf-noto-emoji_20190815.bb"
TTF_FONTS:remove = "ttf-noto-emoji-color"

LAYERSERIES_COMPAT_toradex-agl = "kirkstone"
```
